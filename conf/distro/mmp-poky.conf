## conf/distro/mmp-poky.conf
```bitbake
DISTROOVERRIDES =. "poky:"

require conf/distro/poky.conf

INHERIT += "mender-full"
INIT_MANAGER = "systemd"
```

## conf/layer.conf
```bitbake
# We have a conf and classes directory, add to BBPATH
BBPATH .= ":${LAYERDIR}"

# We have recipes-* directories, add to BBFILES
BBFILES += "${LAYERDIR}/recipes-*/*/*.bb \
            ${LAYERDIR}/recipes-*/*/*.bbappend"

BBFILE_COLLECTIONS += "mender-multiplatform"
BBFILE_PATTERN_mender-multiplatform = "^${LAYERDIR}/"
BBFILE_PRIORITY_mender-multiplatform = "6"

# we only list direct dependencies!
LAYERDEPENDS_mender-multiplatform = " \
	core \
	mender-community-beaglebone \
	mender-demo \
	mender-raspberrypi"

LAYERSERIES_COMPAT_mender-multiplatform = "dunfell"
```

## conf/machine/include/raspberrypi.conf
```bitbake
RPI_USE_U_BOOT = "1"
MENDER_BOOT_PART_SIZE_MB = "80"
IMAGE_INSTALL:append = " kernel-image kernel-devicetree"
IMAGE_FSTYPES:remove += " rpi-sdimg"

ENABLE_UART = "1"
```

## conf/machine/mmp-raspberrypi3.conf
```bitbake
MACHINEOVERRIDES =. "raspberrypi3:"

require conf/machine/raspberrypi3.conf
require conf/machine/include/raspberrypi.conf
```
